## ESP32/main/Kconfig.projbuild
```kconfig
menu "App Configuration"

    config BROKER_URL
        string "Broker URL"
        default "mqtt://mqtt.eclipseprojects.io"
        help
            URL of the broker to connect to
            eg.:"mqtt://username:password@server_ip:server_port"

    choice DEBUG_MODE
        prompt "debug mode"
        default DEBUG_MODE_OFF
        help
            Selection of debug mode.

        config DEBUG_MODE_ON
            bool "debug mode"

        config DEBUG_MODE_OFF
            bool "normal mode"
    endchoice
    choice MB_COMM_MODE
        prompt "Modbus communication mode"
        default MB_COMM_MODE_TCP if FMB_COMM_MODE_TCP_EN
        help
            Selection of Modbus communication mode option for Modbus.

        config MB_COMM_MODE_RTU
            bool "RTU mode"
            depends on FMB_COMM_MODE_RTU_EN

        config MB_COMM_MODE_ASCII
            bool "ASCII mode"
            depends on FMB_COMM_MODE_ASCII_EN

        config MB_COMM_MODE_TCP
            bool "TCP mode"
            depends on FMB_COMM_MODE_TCP_EN
    endchoice

    config SLAVE_IP_ADDRESS
        string "slave ip address"
        default  "192.168.0.208"
        depends on MB_COMM_MODE_TCP
        help
            IP of the MODBUS SLAVE to connect to

    config MB_UART_PORT_NUM
        int "UART port number"
        range 0 2 if IDF_TARGET_ESP32 || IDF_TARGET_ESP32S3
        default 2 if IDF_TARGET_ESP32
        default 1 if IDF_TARGET_ESP32S3
        range 0 1 if IDF_TARGET_ESP32S2 || IDF_TARGET_ESP32C3 || IDF_TARGET_ESP32C2 || IDF_TARGET_ESP32H2
        default 1 if IDF_TARGET_ESP32S2 || IDF_TARGET_ESP32C3 || IDF_TARGET_ESP32C2 || IDF_TARGET_ESP32H2
        depends on MB_COMM_MODE_ASCII || MB_COMM_MODE_RTU
        help
            UART communication port number for the example.
            See UART documentation for available port numbers.

    config MB_UART_BAUD_RATE
        int "UART communication speed"
        range 1200 115200
        default 38400
        depends on MB_COMM_MODE_ASCII || MB_COMM_MODE_RTU
        help
            UART communication speed for Modbus example.

    config MB_UART_RXD
        int "UART RXD pin number"
        range 0 48
        default 16 if IDF_TARGET_ESP32
        default 18 if IDF_TARGET_ESP32S3
        default 8 if !IDF_TARGET_ESP32
        depends on MB_COMM_MODE_ASCII || MB_COMM_MODE_RTU
        help
            GPIO number for UART RX pin. See UART documentation for more information
            about available pin numbers for UART.

    config MB_UART_TXD
        int "UART TXD pin number"
        range 0 48
        default 17 if IDF_TARGET_ESP32 || IDF_TARGET_ESP32S3
        default 9 if !IDF_TARGET_ESP32
        depends on MB_COMM_MODE_ASCII || MB_COMM_MODE_RTU
        help
            GPIO number for UART TX pin. See UART documentation for more information
            about available pin numbers for UART.

    config MB_UART_RTS
        int "UART RTS pin number"
        range 0 48
        default 4 if IDF_TARGET_ESP32
        default 8 if IDF_TARGET_ESP32S3
        default 10 if !IDF_TARGET_ESP32
        depends on MB_COMM_MODE_ASCII || MB_COMM_MODE_RTU
        help
            GPIO number for UART RTS pin. This pin is connected to
            ~RE/DE pin of RS485 transceiver to switch direction.
            See UART documentation for more information about available pin
            numbers for UART.

    config MQTT_RQUEST
        string "slave read/write request mqtt"
        default  "request"
        help
            slave read/write request mqtt

    config MQTT_RESPONSE
        string "slave read/write response mqtt"
        default  "response"
        help
            slave read/write response mqtt

    config MQTT_STATUS
        string "status mqtt"
        default  "status"
        help
            status mqtt of ESP32
endmenu
```
